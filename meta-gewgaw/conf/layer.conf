## meta-gewgaw/conf/layer.conf
```bitbake
# Layer configuration for meta-gewgaw
BBPATH .= ":${LAYERDIR}"

BBFILES += "${LAYERDIR}/recipes-*/*/*.bb \
            ${LAYERDIR}/recipes-*/*/*.bbappend"

BBFILE_COLLECTIONS += "gewgaw"
BBFILE_PATTERN_gewgaw = "^${LAYERDIR}/"
BBFILE_PRIORITY_gewgaw = "10"

LAYERDEPENDS_gewgaw = "core raspberrypi"
LAYERSERIES_COMPAT_gewgaw = "scarthgap"

LAYERVERSION_gewgaw = "1"
```
